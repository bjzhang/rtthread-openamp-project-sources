## Config.in
```kconfig
source "$BR2_EXTERNAL_OPENAMP_PROJECT_PATH/port_linux/libmetal/Config.in"
source "$BR2_EXTERNAL_OPENAMP_PROJECT_PATH/port_linux/openamp/Config.in"
:
```

## port_linux/libmetal/Config.in
```kconfig
config BR2_PACKAGE_LIBMETAL
	bool "libmetal"
	help
	  libmetal port for Linux and riscv64
```

## port_linux/openamp/Config.in
```kconfig
config BR2_PACKAGE_OPENAMP
	bool "openamp"
	help
	  open-amp port for Linux and riscv64
```

## port_linux/openamp_drv/Config.in
```kconfig
config BR2_PACKAGE_OPENAMP_DRV
	bool "openamp_drv"
	help
	  OpenAMP driver for Linux
```
